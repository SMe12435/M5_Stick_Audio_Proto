## sdkconfig.defaults
```kconfig
# Arduino compatibility
CONFIG_FREERTOS_HZ=1000
CONFIG_AUTOSTART_ARDUINO=y
CONFIG_ENABLE_ARDUINO_DEPENDS=y

# Flash
CONFIG_ESPTOOLPY_FLASHSIZE_4MB=y

# Bluetooth controller: BR/EDR + BLE (required for A2DP/HFP)
CONFIG_BTDM_CTRL_MODE_BTDM=y
CONFIG_BTDM_CTRL_BR_EDR_MAX_ACL_CONN=2
CONFIG_BTDM_CTRL_BR_EDR_MAX_SYNC_CONN=2
CONFIG_BTDM_CTRL_BR_EDR_SCO_DATA_PATH_HCI=y
CONFIG_BTDM_CTRL_LEGACY_AUTH_VENDOR_EVT=y
CONFIG_BTDM_CTRL_LEGACY_AUTH_VENDOR_EVT_EFF=y

# Bluetooth host stack
CONFIG_BT_ENABLED=y
CONFIG_BT_BLUEDROID_ENABLED=y
CONFIG_BT_CLASSIC_ENABLED=y
CONFIG_BT_A2DP_ENABLE=y
CONFIG_BT_SSP_ENABLED=y
CONFIG_BT_BTC_TASK_STACK_SIZE=8192
CONFIG_BT_BTU_TASK_STACK_SIZE=8192

# HFP
CONFIG_BT_HFP_ENABLE=y
CONFIG_BT_HFP_CLIENT_ENABLE=y
CONFIG_BT_HFP_AG_ENABLE=y
CONFIG_BT_HFP_WBS_ENABLE=y
# CONFIG_BT_HFP_AUDIO_DATA_PATH_PCM is not set
CONFIG_BT_HFP_AUDIO_DATA_PATH_HCI=y

# SPP (needed by ESP32-A2DP library)
CONFIG_BT_SPP_ENABLED=y

# PSRAM
CONFIG_ESP32_SPIRAM_SUPPORT=y
CONFIG_SPIRAM=y
CONFIG_SPIRAM_USE_MALLOC=y
CONFIG_SPIRAM_CACHE_WORKAROUND=y

# Optimize for size to avoid IRAM overflow
CONFIG_COMPILER_OPTIMIZATION_SIZE=y
```
